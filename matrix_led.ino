#define CD4017_CLK PORTB1
#define CD4017_RST PORTB2
#define SERIAL_DATA PORTB3
#define ST_CLK PORTB4
#define SH_CLK PORTB5
#define DELAY 15
#define MAX_CHARS 100

/*
 char_data is a two dimensional constant array that holds the 5-bit column values
 of individual rows for ASCII characters that are to be displayed on a 7x10 matrix. 
*/
const byte char_data[95][7]={
    {0x0, 0x0, 0x0, 0x0, 0x0, 0x0, 0x0}, // space
    {0x4, 0x4, 0x4, 0x4, 0x4, 0x0, 0x4}, // !
    {0xA, 0xA, 0xA, 0x0, 0x0, 0x0, 0x0}, // "
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    {0x0, 0x0, 0x0, 0xA, 0x15, 0x0, 0x0}, // ~
};
uint16_t frame_buffer[7];
char message[MAX_CHARS] = "MATRIX LED 7X10  ";
byte string_length = strlen(message);

void set_bit(byte bitnum){
    PORTB |= (1 << bitnum);
}

void clr_bit(byte bitnum){
    PORTB &= ~(1 << bitnum);
}

void bit_data(byte bitnum, bool val){
    if (val) set_bit(bitnum);
    else clr_bit(bitnum);
}

void set_clr_bit(byte bitnum){
    set_bit(bitnum);
    clr_bit(bitnum);
}

void send_data(uint16_t data){
    for (uint16_t mask = 1; mask & 0x3ff; mask <<= 1){ // Extracts one bit at a time from the data 10 times starting with the LSB.
        bit_data(SERIAL_DATA, data & mask); // Set data pin high if the current bit is 1, else set data pin low.
        set_clr_bit(SH_CLK); // Set and reset clock pin, telling the shift register to read in the current data pin value.
    }
    set_clr_bit(ST_CLK); // Set and reset latch pin to display the data at the output of the shift registers.
}

void send_frame_buffer(){
    for (byte t = 0; t < DELAY; t++){ // The delay we get with loops.
        for (byte row = 0; row < 7; row++){ // For each row.
            send_data(frame_buffer[row]); // Send 10 bits to shift registers.
            delayMicroseconds(800); // This delay defines the time to play each pattern.
            send_data(0); // Clear the row so we can go on to the next row without smearing.
            set_clr_bit(CD4017_CLK); // On to the next row.
        }
        set_clr_bit(CD4017_RST);  // Select the first row.
    }
}

void load_char(byte pos){
    byte mask = 0x10;
    for (byte column = 0; column < 5; column++){
        for (byte row = 0; row < 7; row++){  
            byte index = message[pos]; 
            byte temp = char_data[index-32][row];
            frame_buffer[row] = (frame_buffer[row]<<1) | ((temp&mask)>>4-column);
        }
        send_frame_buffer();
        mask >>= 1;
    }
}

void display_message(){
    for (byte c = 0;  c < string_length; c++){
        load_char(c);
        for (byte row = 0; row < 7; row++){ // One column of separation between characters.
            frame_buffer[row] <<= 1;
        }
        send_frame_buffer();
    }
}

int main(){
    DDRB = 0b111111; // PORTB as output.
    set_clr_bit(CD4017_RST); // Makes sure the 4017 value is 0.
    send_data(0); // Clear shift registers.
    
    while (true){
        display_message();
    }
}
